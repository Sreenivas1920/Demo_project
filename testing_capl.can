/*@!Encoding:1252*/

includes
{
  // You can include additional CAPL libraries if required
}

variables
{
  message 0x100 mymsg;     // Declare CAN message with ID 0x100
  msTimer msgtimer;        // Declare a timer variable
}

/* ---------------------- Initialization ---------------------- */
on start
{
  // Start the timer for the first time (1 second)
  setTimer(msgtimer, 1000);
}

/* ---------------------- Function Definition ---------------------- */
void sendCANmessage()
{
  // Prepare CAN message data
  mymsg.byte(0) = 0x11;
  mymsg.byte(1) = 0x12;
  mymsg.byte(2) = 0x13;
  mymsg.byte(3) = 0x14;
  mymsg.dlc = 4;                // Set data length (important!)
  
  // Transmit the message on the CAN bus
  output(mymsg);

  // Restart the timer for cyclic sending
  setTimer(msgtimer, 1000);
}

/* ---------------------- Timer Event ---------------------- */
on timer msgtimer
{
  // Call the user-defined function to send the message
  sendCANmessage();
}
