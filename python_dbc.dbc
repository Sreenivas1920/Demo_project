VERSION ""

NS_ :

BS_:

BU_: IPC BCM

BO_ 256 BCMMessage: 1 BCM
 SG_ BCMSignal : 0|1@1+ (1,0) [0|1] "" Vector__XXX

BA_DEF_ BO_  "ILUsed" ENUM  "YES","NO";
BA_DEF_ BO_  "GenMsgSendType" ENUM  "FixedPeriodic","EventPeriodic","Event";
BA_DEF_ BO_  "GenMsgCycleTime" INT 0 10000;
BA_DEF_DEF_  "ILUsed" "YES";
BA_DEF_DEF_  "GenMsgSendType" "FixedPeriodic";
BA_DEF_DEF_  "GenMsgCycleTime" 50;
BA_ "GenMsgCycleTime" BO_ 256 100;
